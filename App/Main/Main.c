/*********************************************************************************************************
* 模块名称：Main.c
* 摘    要：主文件，包含软硬件初始化函数和main函数
* 当前版本：1.0.0
* 作    者：YYW
* 完成日期：2026年05月10日
* 内    容：
* 注    意：注意勾选Options for Target 'Target1'->Code Generation->Use MicroLIB，否则printf无法使用                                                                  
**********************************************************************************************************
* 取代版本：
* 作    者：
* 完成日期：
* 修改内容：
* 修改文件：
*********************************************************************************************************/

/*********************************************************************************************************
*                                              包含头文件
*********************************************************************************************************/
#include "Main.h"
#include "stm32f10x_conf.h"
#include "FreeRTOS.h"
#include "task.h"
#include "queue.h"
#include "event_groups.h"
#include "common.h"
#include "DataType.h"
#include "NVIC.h"
#include "RCC.h"
#include "UART1.h"
#include "LED.h"
#include "KeyOne.h"
#include "ProcKeyOne.h"
#include "PWM.h"
#include "Motor.h"
#include "Audio.h"
#include "Heat.h"

/*********************************************************************************************************
*                                              宏定义
*********************************************************************************************************/

/*********************************************************************************************************
*                                              全局句柄定义
*********************************************************************************************************/
QueueHandle_t g_msgQueue = NULL;

/*********************************************************************************************************
*                                              枚举结构体定义
*********************************************************************************************************/

/*********************************************************************************************************
*                                              内部函数声明
*********************************************************************************************************/
static  void  InitHardware(void);   //初始化硬件相关的模块

/*********************************************************************************************************
*                                              内部函数实现
*********************************************************************************************************/

/*********************************************************************************************************
* 函数名称：InitHardware
* 函数功能：所有的硬件相关的模块初始化函数都放在此函数中
* 输入参数：void
* 输出参数：void
* 返 回 值：void
* 创建日期：2018年01月01日
* 注    意：
*********************************************************************************************************/
static  void  InitHardware(void)
{  
  SystemInit();       //系统初始化
  InitRCC();          //初始化RCC模块
  InitNVIC();         //初始化NVIC模块
  InitUART1(9600);    //初始化UART模块
  InitLED();          //初始化LED模块
  InitKeyOne();       //初始化KeyOne模块
  InitProcKeyOne();   //初始化ProcKeyOne模块
  InitPWM();          //初始化PWM模块
  InitMotor();        //初始化Motor模块
  InitAudio();        //初始化Audio模块
  InitHeat();         //初始化Heat模块
}
/*********************************************************************************************************
* 函数名称：ModeTask
* 函数功能：模式管理任务 
* 输入参数：void
* 输出参数：void
* 返 回 值：void
* 创建日期：2026年05月14日
* 注    意：
*********************************************************************************************************/
static void ModeTask(void *parameters)        //进行模式管理任务调度
{
  AppMsg msg;
  while(1){
    if(xQueueReceive(g_msgQueue,&msg,portMAX_DELAY)){     //检测消息
      switch(msg.type){
        case MSG_MODE_CHANGE:                             //改变模式
          g_currentMode = (SystemMode)((g_currentMode + 1) % SYS_MODE_MAX); 
          AudioPlayMode();    //语音播报模式
          //SetTemp();
          break;

        case MSG_N8900_CHANGE:
          g_n8900Mode = (AudioMode)((g_n8900Mode + 1) % AUDIO_MODE_MAX);
          AudioChangeMode();
          break;
        default: break;
      }
    }
  }
}

void TaskModeCreate(void)
{
   xTaskCreate(ModeTask,"ModeTask",512,NULL,3,NULL);
}

/*********************************************************************************************************
* 函数名称：main
* 函数功能：主函数 
* 输入参数：void
* 输出参数：void
* 返 回 值：int
* 创建日期：2026年05月11日
* 注    意：
*********************************************************************************************************/
int main(void)
{ 
  InitHardware();   //初始化硬件相关函数

  g_msgQueue = xQueueCreate(10,sizeof(AppMsg));   //创建消息队列

  TaskModeCreate();
  TaskKeyCreate();                  //创建按键任务
  // TaskMotorCreate();                //创建马达任务
  // TaskHeatCreate();                 //创建加热任务
  vTaskStartScheduler();

  while(1);
}
