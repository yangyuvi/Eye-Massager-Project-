/*********************************************************************************************************
* 模块名称：Audio.c
* 摘    要：Audio模块
* 当前版本：1.0.0
* 作    者：YYW
* 完成日期：2026年05月11日 
* 内    容：
* 注    意：                                                                  
**********************************************************************************************************
* 取代版本：
* 作    者：
* 完成日期：
* 修改内容：
* 修改文件：
*********************************************************************************************************/

/*********************************************************************************************************
*                                              包含头文件
*********************************************************************************************************/
#include "Audio.h"
#include "stm32f10x_conf.h"
#include "UART1.h"
#include "common.h"
#include "LED.h"

/*********************************************************************************************************
*                                              宏定义
*********************************************************************************************************/
/*********************************************************************************************************
*                                              枚举结构体定义
*********************************************************************************************************/

/*********************************************************************************************************
*                                              内部变量
*********************************************************************************************************/

/*********************************************************************************************************
*                                              内部函数声明
*********************************************************************************************************/

/*********************************************************************************************************
*                                              内部函数实现
*********************************************************************************************************/
// static  void  ConfigAudioGPIO(void)
// {
//   GPIO_InitTypeDef GPIO_InitStructure;  //GPIO_InitStructure用于存放GPIO的参数
                                                                     
//   //使能RCC相关时钟
//   RCC_APB2PeriphClockCmd(RCC_APB2Periph_GPIOB, ENABLE); //使能GPIOC的时钟
                                                                                                                 
//   GPIO_InitStructure.GPIO_Pin   = GPIO_Pin_10;           //设置引脚
//   GPIO_InitStructure.GPIO_Speed = GPIO_Speed_50MHz;     //设置I/O输出速度
//   GPIO_InitStructure.GPIO_Mode  = GPIO_Mode_Out_PP;        //设置模式
//   GPIO_Init(GPIOB, &GPIO_InitStructure);                //根据参数初始化GPIO
// }

/*********************************************************************************************************
* 函数名称：N8900SetBTMode
* 函数功能：切换到蓝牙模式
* 输入参数：void
* 输出参数：void
* 返 回 值：void
* 创建日期：2026年05月13日
* 注    意：
*********************************************************************************************************/
static void N8900SetBTMode(void)
{
  N8900SendCmd(N8900_MODE_BT,NULL,0);
}

static void N8900SetMusicMode(void)
{
  N8900SendCmd(N8900_MODE_MUSIC,NULL,0);
}
/*********************************************************************************************************
* 函数名称：N8900BTConnect
* 函数功能：发起蓝牙连接
* 输入参数：void
* 输出参数：void
* 返 回 值：void
* 创建日期：2026年05月13日
* 注    意：
*********************************************************************************************************/
static void N8900BTConnect(void)
{
  N8900SendCmd(BT_CONNECT,NULL,0);
}

/*********************************************************************************************************
* 函数名称：N8900BTDisconnect
* 函数功能：断开蓝牙连接
* 输入参数：void
* 输出参数：void
* 返 回 值：void
* 创建日期：2026年05月13日
* 注    意：
*********************************************************************************************************/
static void N8900BTDisconnect(void)
{
  N8900SendCmd(BT_DISCONNECT,NULL,0);
}

/*********************************************************************************************************
* 函数名称：N8900SetVolume
* 函数功能：设置音量大小
* 输入参数：void
* 输出参数：void
* 返 回 值：void
* 创建日期：2026年05月13日
* 注    意：
*********************************************************************************************************/
static void N8900SetVolume(u8 *vol)
{
  N8900SendCmd(N8900_VOLUME_SET,vol,1);
}

/*********************************************************************************************************
*                                              API函数实现
*********************************************************************************************************/
/*********************************************************************************************************
* 函数名称：InitAudio
* 函数功能：初始化Audio模块
* 输入参数：void
* 输出参数：void
* 返 回 值：void
* 创建日期：2026年05月11日
* 注    意：
*********************************************************************************************************/
void InitAudio(void)
{
  // ConfigAudioGPIO();
}

/*********************************************************************************************************
* 函数名称：N8900SendCmd
* 函数功能：发送指令
* 输入参数：cmdType指令类型，data数据，len数据长度
* 输出参数：void
* 返 回 值：void
* 创建日期：2026年05月13日
* 注    意：通信数据格式由[起始码][指令类型][数据长度][数据1][数据2][...][数据n][校验和]组成
*********************************************************************************************************/
void N8900SendCmd(u8 cmdType, u8 *data, u8 len)
{
  u8 i;
  u8 sendBuf[10];
  u16 checkSum = 0;

  sendBuf[0] = 0xAA;      //起始码，固定为0xAA
  sendBuf[1] = cmdType;   //指令类型
  sendBuf[2] = len;       //数据长度

  checkSum = sendBuf[0] ^ sendBuf[1] ^ sendBuf[2];    //异或值校验    

  for(i=0;i<len;i++){
    sendBuf[3+i] = data[i];
    checkSum ^= data[i];
  }

  sendBuf[3+len] = checkSum;     

  //通过串口发送
  WriteUART1(sendBuf,len+4);
}

/*********************************************************************************************************
* 函数名称：N8900_IsBusy
* 函数功能：检测N8900模块是否正在播放
* 输入参数：void
* 输出参数：void
* 返 回 值：void
* 创建日期：2026年05月16日
* 注    意：
*********************************************************************************************************/
// u8 N8900_IsBusy(void)
// {
//     // BUSY 低电平 = 正在播放，高电平 = 空闲
//     return (GPIO_ReadInputDataBit(GPIOB, GPIO_Pin_10) == 0);
// }

/*********************************************************************************************************
* 函数名称：AudioPlayMode
* 函数功能：语音播报当前模式
* 输入参数：void
* 输出参数：void
* 返 回 值：void
* 创建日期：2026年05月16日
* 注    意：
*********************************************************************************************************/
void AudioPlayMode(void)
{
  u8 vol=6;
  u8 loopMode;
  u8 data2[2];
  u16 song = 0;
  u16 bgm = 0;

  //匹配需要播放的曲目
  switch (g_currentMode) {
    case SYS_MODE_STRONG:
      song = VOICE_MODE_STRONG; 
      bgm = SONG_STRONG;        
      break;
    case SYS_MODE_PULSE:
      song = VOICE_MODE_PULSE;
      bgm = SONG_PULSE;
      break;
    case SYS_MODE_SLEEP:
      song = VOICE_MODE_SLEEP;
      bgm = SONG_SLEEP;
      break;
    default: break;
  }

  loopMode = SINGLE_SONG_STOP;
  data2[0] = (song >> 8) & 0xFF;   //高字节
  data2[1] = song & 0xFF;          //低字节

  N8900SetVolume(&vol);
  vTaskDelay(pdMS_TO_TICKS(100));
  // if(g_n8900Mode!=AUDIO_MODE_MUSIC){
    // N8900SetMusicMode();  //音乐模式
    // vTaskDelay(pdMS_TO_TICKS(300));
  // }
  N8900SendCmd(N8900_FLASH_PLAY,NULL,0);  //Flash播放
  vTaskDelay(pdMS_TO_TICKS(200));
  N8900SendCmd(LOOP_MODE,&loopMode,1);       //循环模式设置为单曲停止
  vTaskDelay(pdMS_TO_TICKS(100));
  N8900SendCmd(SELECT_TRACK,data2,2);     //选择播放的曲目,两字节数据分别为曲目序号的高低字节
  vTaskDelay(pdMS_TO_TICKS(1800));

  //监听BUSY引脚，等待播放完成
  // while (N8900_IsBusy()) {
  //   LEDOn();
  //   vTaskDelay(pdMS_TO_TICKS(50));  // 每 50ms 检测一次
  // }
  //   LEDOff();

  loopMode = SINGLE_SONG_LOOP;
  N8900SendCmd(LOOP_MODE,&loopMode,1);       
  vTaskDelay(pdMS_TO_TICKS(100));

  data2[0] = (bgm >> 8) & 0xFF;   //高字节
  data2[1] = bgm & 0xFF;          //低字节
  N8900SendCmd(SELECT_TRACK,data2,2);     //选择播放的曲目,两字节数据分别为曲目序号的高低字节

}

/*********************************************************************************************************
* 函数名称：AudioPlayMode
* 函数功能：语音播报当前模式
* 输入参数：void
* 输出参数：void
* 返 回 值：void
* 创建日期：2026年05月16日
* 注    意：
*********************************************************************************************************/
void AudioChangeMode(void)
{
  switch (g_n8900Mode)
  {
  case AUDIO_MODE_MUSIC:
    N8900SetMusicMode();
    break;
  case AUDIO_MODE_BT:
    N8900SetBTMode();
    break;
  default:
    break;
  }
}