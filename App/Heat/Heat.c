/*********************************************************************************************************
* 模块名称：Heat.c
* 摘    要：Heat模块
* 当前版本：1.0.0
* 作    者：YYW
* 完成日期：2026年05月11日 
* 内    容：加热模块
* 注    意：                                                                  
**********************************************************************************************************
* 取代版本：
* 作    者：
* 完成日期：
* 修改内容：
* 修改文件：
*********************************************************************************************************/

/*********************************************************************************************************
*                                              包含头文件
*********************************************************************************************************/
#include "Heat.h"
#include "stm32f10x_conf.h"
#include "ADC.h"
#include "common.h"

/*********************************************************************************************************
*                                              宏定义
*********************************************************************************************************/
#define HYSTTEMP 1      //1°C的回差
#define HIGHTEMP 50     //过热保护

#define Rfixed 10       //分压电阻为10k欧

#define TASK_HEAT_STACK_SIZE  256
#define TASK_HEAT_PRIO        2
/*********************************************************************************************************
*                                              枚举结构体定义
*********************************************************************************************************/
typedef struct{
  float rval;
  u8 temp;
}RTTable_t;
/*********************************************************************************************************
*                                              内部变量
*********************************************************************************************************/
TaskHandle_t s_tempTaskHandle = NULL;

static u8 s_maxTemp;

const RTTable_t RTTable[] = {
  {3.454, 51},{3.572, 50},{3.730, 49},{3.877, 48},{4.031, 47},{4.192, 46},
  {4.360, 45},{4.536, 44},{4.720, 43},{4.913, 42},{5.114, 41},{5.324, 40},
  {5.525, 39},{5.775, 38}
};

#define TABLE_SIZE  (sizeof(RTTable) / sizeof(RTTable[0]))

/*********************************************************************************************************
*                                              内部函数声明
*********************************************************************************************************/
static  void  ConfigHeatGPIO(void);  //配置Heat的GPIO

/*********************************************************************************************************
*                                              内部函数实现
*********************************************************************************************************/
/*********************************************************************************************************
* 函数名称：ConfigHeatGPIO
* 函数功能：配置Heat的GPIO 
* 输入参数：void 
* 输出参数：void
* 返 回 值：void
* 创建日期：2026年05月11日
* 注    意：
*********************************************************************************************************/
static  void  ConfigHeatGPIO(void)
{
  GPIO_InitTypeDef GPIO_InitStructure;  //GPIO_InitStructure用于存放GPIO的参数
                                                                     
  //使能RCC相关时钟
  RCC_APB2PeriphClockCmd(RCC_APB2Periph_GPIOB, ENABLE); //使能GPIOB的时钟
                                                                                                                 
  GPIO_InitStructure.GPIO_Pin   = GPIO_Pin_7|GPIO_Pin_8|GPIO_Pin_9;           //设置引脚
  GPIO_InitStructure.GPIO_Speed = GPIO_Speed_50MHz;     //设置I/O输出速度
  GPIO_InitStructure.GPIO_Mode  = GPIO_Mode_Out_PP;     //设置模式
  GPIO_Init(GPIOB, &GPIO_InitStructure);                //根据参数初始化GPIO
}

/*********************************************************************************************************
*                                              API函数实现
*********************************************************************************************************/
/*********************************************************************************************************
* 函数名称：InitHeat
* 函数功能：初始化Heat模块
* 输入参数：void
* 输出参数：void
* 返 回 值：void
* 创建日期：2026年05月11日
* 注    意：
*********************************************************************************************************/
void InitHeat(void)
{
  ConfigHeatGPIO();  //配置Heat的GPIO
}

/*********************************************************************************************************
* 函数名称：HeatOn
* 函数功能：开启加热模块
* 输入参数：void
* 输出参数：void
* 返 回 值：void
* 创建日期：2026年05月12日
* 注    意：
*********************************************************************************************************/
void HeatOn(void)
{
  GPIO_WriteBit(GPIOB, GPIO_Pin_7, Bit_SET);    
  GPIO_WriteBit(GPIOB, GPIO_Pin_8, Bit_SET);  
  GPIO_WriteBit(GPIOB, GPIO_Pin_9, Bit_SET);    
}

/*********************************************************************************************************
* 函数名称：HeatOff
* 函数功能：关闭加热模块
* 输入参数：void
* 输出参数：void
* 返 回 值：void
* 创建日期：2026年05月12日
* 注    意：
*********************************************************************************************************/
void HeatOff(void)
{
  GPIO_WriteBit(GPIOB, GPIO_Pin_7, Bit_RESET);    
  GPIO_WriteBit(GPIOB, GPIO_Pin_8, Bit_RESET);  
  GPIO_WriteBit(GPIOB, GPIO_Pin_9, Bit_RESET);       
}
/*********************************************************************************************************
* 函数名称：ConvertAdcToTemp
* 函数功能：将单个ADC值转换为温度
* 输入参数：adc值
* 输出参数：温度值
* 返 回 值：float
* 创建日期：2026年05月18日
* 注    意：
*********************************************************************************************************/
static float ConvertAdcToTemp(u16 adcVal)
{
  u8 i;
  u8 temp = 0;

  //读取ADC值转电压值
  float vol = adcVal * 3.3f / 4095.0f;
  //安全限幅
  if (vol >= 3.299f) vol = 3.299f;

  //由电压值对应热敏电阻阻值
  float rntc = Rfixed * vol / (3.3f - vol);
 
  //查表法,阻值转换为温度,温度越高阻值越小
  for(i = 0; i < TABLE_SIZE; i++){
    if(rntc <= RTTable[i].rval){
      temp = RTTable[i].temp;
      break;
    }
  }
  return temp;
}

/*********************************************************************************************************
* 函数名称：DetectTemp
* 函数功能：检测温度模块
* 输入参数：void
* 输出参数：温度值
* 返 回 值：u8
* 创建日期：2026年05月12日
* 注    意：
*********************************************************************************************************/
void DetectTemp(void)
{
  u8 leftTemp = ConvertAdcToTemp(GetADCVal1());
  u8 rightTemp = ConvertAdcToTemp(GetADCVal2());

  //取两温度值中较高的一个
  s_maxTemp = (leftTemp > rightTemp) ? leftTemp : rightTemp;
}

/*********************************************************************************************************
* 函数名称：HeatTask
* 函数功能：控制温度模块,使温度维持在固定值
* 输入参数：要设定的温度temp
* 输出参数：void
* 返 回 值：void
* 创建日期：2026年05月12日
* 注    意：开关控制
*********************************************************************************************************/
static void HeatTask(void *para)
{
  u8 targetTemp = 45;

  while(1){
    DetectTemp();    //读取当前温度
    
    if(s_maxTemp >= HIGHTEMP)            //过热保护
    {
      HeatOff();
    }
    else if(s_maxTemp < targetTemp - HYSTTEMP){   //当前温度小于设定温度
      HeatOn();                           //开启加热
    }
    else if(s_maxTemp > targetTemp + HYSTTEMP){
      HeatOff();                          //关闭加热
    }
    vTaskDelay(pdMS_TO_TICKS(100));
  }
}

void TaskHeatCreate(void)
{
  xTaskCreate(HeatTask, "HeatTask", TASK_HEAT_STACK_SIZE,
              NULL, TASK_HEAT_PRIO, &s_tempTaskHandle);
}
