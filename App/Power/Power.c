/*********************************************************************************************************
* 模块名称：Power.c
* 摘    要：Power模块
* 当前版本：1.0.0
* 作    者：YYW
* 完成日期：2026年05月19日 
* 内    容：
* 注    意：                                                                  
**********************************************************************************************************
* 取代版本：
* 作    者：
* 完成日期：
* 修改内容：
* 修改文件：
*********************************************************************************************************/

/*********************************************************************************************************
*                                              包含头文件
*********************************************************************************************************/
#include "Power.h"
#include "stm32f10x_conf.h"
#include "FreeRTOS.h"
#include "task.h"
#include "LED.h"

/*********************************************************************************************************
*                                              宏定义
*********************************************************************************************************/
#define TASK_CHG_PRIO       1
#define TASK_CHG_STACK_SIZE 256
static TaskHandle_t s_chgTaskHandle = NULL;

/*********************************************************************************************************
*                                              枚举结构体定义
*********************************************************************************************************/
//充电状态
typedef enum{
  CHG_CHARGING = 0,     //正在充电
  CHG_IDLE,             //放电
  CHG_CHARGED           //充电完成
}BatState_t;

//电源状态
typedef enum {
  PWR_OFF = 0,        // 关机
  PWR_ON             // 开机运行
  // PWR_STANDBY         // 待机（低功耗）
} PwrState_t;

/*********************************************************************************************************
*                                              内部变量
*********************************************************************************************************/
PwrState_t pwrState;
/*********************************************************************************************************
*                                              内部函数声明
*********************************************************************************************************/
static  void  ConfigPowerGPIO(void);  //配置Power的GPIO

/*********************************************************************************************************
*                                              内部函数实现
*********************************************************************************************************/
/*********************************************************************************************************
* 函数名称：ConfigPowerGPIO
* 函数功能：配置Power的GPIO 
* 输入参数：void 
* 输出参数：void
* 返 回 值：void
* 创建日期：2026年05月19日
* 注    意：
*********************************************************************************************************/
static  void  ConfigPowerGPIO(void)
{
  GPIO_InitTypeDef GPIO_InitStructure;  //GPIO_InitStructure用于存放GPIO的参数
                                                                     
  //使能RCC相关时钟
  RCC_APB2PeriphClockCmd(RCC_APB2Periph_GPIOA, ENABLE);         //使能GPIOA的时钟
  RCC_APB2PeriphClockCmd(RCC_APB2Periph_GPIOC, ENABLE);         //使能GPIOC的时钟
                                                                                                                 
  GPIO_InitStructure.GPIO_Pin   = GPIO_Pin_1|GPIO_Pin_2;      //设置引脚
  GPIO_InitStructure.GPIO_Speed = GPIO_Speed_50MHz;           //设置I/O输出速度
  GPIO_InitStructure.GPIO_Mode  = GPIO_Mode_IN_FLOATING;      //设置模式
  GPIO_Init(GPIOA, &GPIO_InitStructure);                      //根据参数初始化GPIO

  GPIO_InitStructure.GPIO_Pin   = GPIO_Pin_4;                 //设置引脚
  GPIO_InitStructure.GPIO_Speed = GPIO_Speed_50MHz;           //设置I/O输出速度
  GPIO_InitStructure.GPIO_Mode  = GPIO_Mode_Out_PP;           //设置模式
  GPIO_Init(GPIOC, &GPIO_InitStructure);                      //根据参数初始化GPIO

  GPIO_SetBits(GPIOC, GPIO_Pin_4);                            //默认开机
}

/*********************************************************************************************************
*                                              API函数实现
*********************************************************************************************************/
/*********************************************************************************************************
* 函数名称：InitPower
* 函数功能：初始化Power模块
* 输入参数：void
* 输出参数：void
* 返 回 值：void
* 创建日期：2026年05月19日
* 注    意：
*********************************************************************************************************/
void InitPower(void)
{
  ConfigPowerGPIO();  //配置Power的GPIO
}

/*********************************************************************************************************
* 函数名称：PowerGetStatus
* 函数功能：获取电池充电状态
* 输入参数：void
* 输出参数：void
* 返 回 值：void
* 创建日期：2026年05月19日
* 注    意：
*********************************************************************************************************/
static BatState_t PowerGetStatus(void)
{
  u8 chrg = GPIO_ReadInputDataBit(GPIOA, GPIO_Pin_1);
  u8 stdby = GPIO_ReadInputDataBit(GPIOA, GPIO_Pin_2);
  BatState_t batState;

  if (chrg == 0 && stdby == 1) {        //表示正在充电
    batState = CHG_CHARGING;
  }   
  else if (chrg == 1 && stdby == 0) {   //表示充电完成
    batState = CHG_CHARGED;
  } 
  else {                                //两个引脚都为高电平，电池处于放电/待机状态
    batState = CHG_IDLE;
  } 
  return batState;
}

static void ChargeTask(void *pvParameters)
{
  BatState_t status;
  while (1)
  {
    status = PowerGetStatus();
    switch (status)
    {
    case CHG_CHARGING:
      LED1On();
      break;
    default:
      LED1Off();
      break;
    }
    vTaskDelay(pdMS_TO_TICKS(500));
  }

}

void TaskChargeCreate(void)
{
  xTaskCreate(ChargeTask, "Charge", TASK_CHG_STACK_SIZE,
              NULL, TASK_CHG_PRIO, &s_chgTaskHandle);
}

/*********************************************************************************************************
* 函数名称：PowerShutdown
* 函数功能：电源开关机
* 输入参数：void
* 输出参数：void
* 返 回 值：void
* 创建日期：2026年05月19日
* 注    意：
*********************************************************************************************************/
void PowerShutdown(void)
{
  //关闭所有外设
  //指示灯

  //断电
  GPIO_ResetBits(GPIOC,GPIO_Pin_4);

  //死循环
  while (1){}
  
}

