/*********************************************************************************************************
* 模块名称：Motor.c
* 摘    要：Motor模块
* 当前版本：1.0.0
* 作    者：YYW
* 完成日期：2026年05月11日 
* 内    容：
* 注    意：                                                                  
**********************************************************************************************************
* 取代版本：
* 作    者：
* 完成日期：
* 修改内容：
* 修改文件：
*********************************************************************************************************/

/*********************************************************************************************************
*                                              包含头文件
*********************************************************************************************************/
#include "Motor.h"
#include "stm32f10x_conf.h"
#include "PWM.h"
#include "ProcKeyOne.h"
#include "UART1.h"
/*********************************************************************************************************
*                                              宏定义
*********************************************************************************************************/
#define START 0
#define STOP 1
/*********************************************************************************************************
*                                              枚举结构体定义
*********************************************************************************************************/

/*********************************************************************************************************
*                                              内部变量
*********************************************************************************************************/

/*********************************************************************************************************
*                                              内部函数声明
*********************************************************************************************************/

/*********************************************************************************************************
*                                              内部函数实现
*********************************************************************************************************/

/*********************************************************************************************************
*                                              API函数实现
*********************************************************************************************************/
/*********************************************************************************************************
* 函数名称：InitMotor
* 函数功能：初始化Motor模块
* 输入参数：void
* 输出参数：void
* 返 回 值：void
* 创建日期：2018年01月01日
* 注    意：
*********************************************************************************************************/
void InitMotor(void)
{
  
}

/*********************************************************************************************************
* 函数名称：StartMotor
* 函数功能：初始化Motor模块
* 输入参数：void
* 输出参数：void
* 返 回 值：void
* 创建日期：2018年01月01日
* 注    意：
*********************************************************************************************************/
void StartMotor(void)
{
  SetPWM(80);
}

/*********************************************************************************************************
* 函数名称：StopMotor
* 函数功能：初始化Motor模块
* 输入参数：void
* 输出参数：void
* 返 回 值：void
* 创建日期：2018年01月01日
* 注    意：
*********************************************************************************************************/
void StopMotor(void)
{
  SetPWM(0);
}

/*********************************************************************************************************
* 函数名称：SetMotorStrength
* 函数功能：初始化Motor模块
* 输入参数：val
* 输出参数：void
* 返 回 值：void
* 创建日期：2018年01月01日
* 注    意：
*********************************************************************************************************/
void SetMotorStrength(u8 val)
{
  SetPWM(val);
}

/*********************************************************************************************************
* 函数名称：SetMotorStrength
* 函数功能：设置Motor模式
* 输入参数：mode
* 输出参数：void
* 返 回 值：void
* 创建日期：2026年05月11日
* 注    意：每10ms调用一次
*********************************************************************************************************/
void SetMotorMode(u8 mode)
{
  static u8 state;
  static u16 cnt;
  
  switch (mode)
  {
  case MODE_STRONG:          //强震模式
    SetPWM(100);
    break;
  case MODE_PULSE:           //脉冲模式，运行4s，停止1s
    cnt++;
    if(state==START){   //启动状态
      StartMotor();
      if(cnt==400){     
        state=STOP;
      }
    }else{              //停止状态
      StopMotor();
      if(cnt==500){
        cnt=0;
        state=START;
      }
    }
    break;
  case MODE_SLEEP:           //睡眠模式
    AlterPWMDutyCycle();  
    break;
    
  default:
    break;
  }
}