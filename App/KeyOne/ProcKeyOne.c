/*********************************************************************************************************
* 模块名称：ProcKeyOne.c
* 摘    要：ProcKeyOne模块，进行独立按键处理模块初始化，以及独立按键处理函数实现
* 当前版本：1.0.0
* 作    者：YYW
* 完成日期：2020年01月01日   
* 内    容：
* 注    意：                                                                  
**********************************************************************************************************
* 取代版本：
* 作    者：
* 完成日期：
* 修改内容：
* 修改文件：
*********************************************************************************************************/

/*********************************************************************************************************
*                                              包含头文件
*********************************************************************************************************/
#include "ProcKeyOne.h"
#include "common.h"
#include "Audio.h"
#include "Power.h"

/*********************************************************************************************************
*                                              宏定义
*********************************************************************************************************/
#define TASK_KEY_STACK_SIZE 256       //栈大小
#define TASK_KEY_PRIO       1         //优先级

static TaskHandle_t KeyTaskHandle = NULL;
SystemMode g_currentMode  = SYS_MODE_STRONG;
AudioMode  g_n8900Mode    = AUDIO_MODE_MUSIC;
/*********************************************************************************************************
*                                              枚举结构体定义
*********************************************************************************************************/

/*********************************************************************************************************
*                                              内部变量
*********************************************************************************************************/

/*********************************************************************************************************
*                                              内部函数声明
*********************************************************************************************************/

/*********************************************************************************************************
*                                              内部函数实现
*********************************************************************************************************/

/*********************************************************************************************************
*                                              API函数实现
*********************************************************************************************************/
/*********************************************************************************************************
* 函数名称：InitProcKeyOne
* 函数功能：初始化ProcKeyOne模块
* 输入参数：void
* 输出参数：void
* 返 回 值：void
* 创建日期：2018年01月01日
* 注    意：
*********************************************************************************************************/
void InitProcKeyOne(void)
{
  
}

/*********************************************************************************************************
* 函数名称：OnKey1Event
* 函数功能：处理按键1事件 
* 输入参数：void
* 输出参数：void
* 返 回 值：void
* 创建日期：2026年05月13日
* 注    意：
*********************************************************************************************************/
void OnKey1Event(KeyEvent event)
{  
  switch (event)
  {
  case KEY_EVENT_UP:
    
    break;
  case KEY_EVENT_DOUBLE:
    
    break;
  case KEY_EVENT_LONG:
    PowerShutdown();
    break;
  default:
    break;
  }
  
}

/*********************************************************************************************************
* 函数名称：OnKey2Event
* 函数功能：处理按键2事件，模式切换
* 输入参数：void
* 输出参数：void
* 返 回 值：void
* 创建日期：2026年05月13日
* 注    意：
*********************************************************************************************************/
void OnKey2Event(KeyEvent event)
{ 
  if (event != KEY_EVENT_UP) return;   // 只响应短按
  AppMsg msg;
  msg.type = MSG_MODE_CHANGE;
  // msg.newMode = (g_currentMode+1) % SYS_MODE_MAX;    //模式切换

  xQueueSend(g_msgQueue, &msg, 0);
  // g_currentMode = msg.newMode;
}

/*********************************************************************************************************
* 函数名称：OnKey3Event
* 函数功能：处理按键3事件，控制音乐播放
* 输入参数：void
* 输出参数：void
* 返 回 值：void
* 创建日期：2026年05月13日
* 注    意：
*********************************************************************************************************/
void OnKey3Event(KeyEvent event)
{  
  AppMsg msg;
  switch (event)
  {
  case KEY_EVENT_UP:
    N8900SendCmd(N8900_PLAY_PAUSE,NULL,0);    //短按播放/暂停
    break;
  case KEY_EVENT_DOUBLE:
    N8900SendCmd(N8900_SONG_NEXT,NULL,0);     //双击下一曲
    break;
  case KEY_EVENT_LONG:
    msg.type = MSG_N8900_CHANGE;
    xQueueSend(g_msgQueue, &msg, 0);
    break;
  default:
    break;
  }
}

/*********************************************************************************************************
* 函数名称：KeyTask
* 函数功能：按键扫描任务
* 输入参数：void
* 输出参数：u8 Mode
* 返 回 值：void
* 创建日期：2026年05月14日
* 注    意：
*********************************************************************************************************/
static void KeyTask(void *parameters)
{
  TickType_t xLastWakeTime = xTaskGetTickCount();

  while (1)
  {
    ScanKeyOne(KEY_NAME_KEY1, OnKey1Event);
    ScanKeyOne(KEY_NAME_KEY2, OnKey2Event);
    ScanKeyOne(KEY_NAME_KEY3, OnKey3Event);
    vTaskDelayUntil(&xLastWakeTime, pdMS_TO_TICKS(10));       //每10ms执行一次
  }

}

void TaskKeyCreate(void)
{
  xTaskCreate(KeyTask, "KeyTask", TASK_KEY_STACK_SIZE, NULL, TASK_KEY_PRIO, &KeyTaskHandle);
}

